#include <SoftwareSerial.h>


#include <Arduino.h>
#if defined(ESP8266)
  #include <ESP8266WiFi.h>
  #include <ESPAsyncTCP.h>
#elif defined(ESP32)
  #include <WiFi.h>
  #include <AsyncTCP.h>
#endif
#include <ESPAsyncWebServer.h>
#include <WebSerial.h>
#include <Adafruit_GFX.h>
#include <Adafruit_SSD1306.h>


#define SCREEN_WIDTH 128
#define SCREEN_HEIGHT 64

SoftwareSerial mySerial(3, 1);

Adafruit_SSD1306 display(SCREEN_WIDTH, SCREEN_HEIGHT, &Wire, -1);
    char inChar;
    String string;

static const uint8_t image_data_Saraarray[1024] = {
    0x00, 0x00, 0x00, 0x00, 0x00, 0x00, 0x00, 0x00, 0x00, 0x00, 0x00, 0x00, 0x00, 0x00, 0x00, 0x00, 
    0x00, 0x00, 0x00, 0x00, 0x00, 0x00, 0x00, 0x00, 0x00, 0x00, 0x00, 0x00, 0x00, 0x00, 0x00, 0x00, 
    0x00, 0x00, 0x00, 0x00, 0x00, 0x00, 0x00, 0x00, 0x00, 0x00, 0x00, 0x00, 0x00, 0x00, 0x00, 0x00, 
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    0x00, 0x00, 0x00, 0x00, 0x00, 0x20, 0x00, 0x00, 0x00, 0x00, 0x00, 0x00, 0x00, 0x00, 0x00, 0x00

};

AsyncWebServer server(80);

const char* ssid = ""; // Your WiFi SSID
const char* password = ""; // Your WiFi Password


/* Message callback of WebSerial */
void recvMsg(uint8_t *data, size_t len){
  WebSerial.println("Received Data...");
  String d = "";
  for(int i=0; i < len; i++){
    d += char(data[i]);
  }
  WebSerial.println(d);
  Serial.println(d);
 
  display.clearDisplay();
  display.setCursor(0,0);
  display.setTextSize(1);
  display.println(d);
  display.display();
  
}

void setup() {
  
    Serial.begin(57600);
    mySerial.begin(57600);
    mySerial.println("Hello, world?");
     
    
    WiFi.mode(WIFI_STA);
    WiFi.begin(ssid, password);
    if (WiFi.waitForConnectResult() != WL_CONNECTED) {
        Serial.printf("WiFi Failed!\n");
        return;
    }
    Serial.print("IP Address: ");
    Serial.println(WiFi.localIP());
    // WebSerial is accessible at "<IP Address>/webserial" in browser
    WebSerial.begin(&server);
    /* Attach Message Callback */
    WebSerial.msgCallback(recvMsg);
    server.begin();
    
    Wire.begin(5, 4);
    if (!display.begin(SSD1306_SWITCHCAPVCC, 0x3C, false, false)) {
        Serial.println(F("SSD1306 allocation failed"));
        for(;;);
    }
    delay(2000); // Pause for 2 seconds
    display.clearDisplay();
    display.drawBitmap(0, 0, image_data_Saraarray, 128, 64, 1);
    display.display();
}


void loop() {
    if (mySerial.available() > 0) {
        mySerial.read();

    char x = mySerial.read(); //read arrived character from FIFO (say 1) and put into x as 0x31 
    Serial.println(x);  //send 0x31 to Serial Monitor to show 1 via UART Port
    WebSerial.println(x);
    display.setCursor(0,0);
    display.setTextSize(1);
    display.println(x);
    display.display();
  }

{
   display.setTextColor(SSD1306_WHITE); // Draw white text
   //display.cp437(true);         // Use full 256 char 'Code Page 437' font   
   display.display();
   while (Serial.available() == 0) {}
   delay(2);
   String inChar  = Serial.readString();
   inChar.trim();
   display.clearDisplay();
   Serial.println(inChar);
   display.setCursor(0,0);
   display.setTextSize(1);
   display.print(inChar);
   display.display();
  }
}
